## Documentation/devicetree/bindings/media/i2c/samsung,s5k5e8.yaml
```yaml
# SPDX-License-Identifier: (GPL-2.0-only OR BSD-2-Clause)
%YAML 1.2
---
$id: http://devicetree.org/schemas/media/i2c/samsung,s5k5e8.yaml#
$schema: http://devicetree.org/meta-schemas/core.yaml#

title: Samsung S5K5E8 Image Sensor

description:
  Samsung S5K5E8 is a 5MP CMOS image sensor controlled over an I2C-compatible
  serial interface, outputting RAW10 image data over a 2-lane MIPI D-PHY
  interface.

maintainers:
  - Andrii Cherniavskyi <chernyav.a@gmail.com>
  - Tuan Kiet Huynh <huynhtuankiet33@gmail.com>

allOf:
  - $ref: /schemas/media/video-interface-devices.yaml#

properties:
  compatible:
    const: samsung,s5k5e8

  reg:
    maxItems: 1

  clocks:
    description: MCLK supply clock.
    maxItems: 1

  reset-gpios:
    description: Active low GPIO connected to RESET pad of the sensor.
    maxItems: 1

  powerdown-gpios:
    description:
      Active low GPIO connected to the XSHUTDN (powerdown) pad of the sensor.
    maxItems: 1

  vdda-supply:
    description: Analogue voltage supply, 2.8 volts.

  vddd-supply:
    description: Digital core voltage supply, 1.2 volts.

  vddio-supply:
    description: Digital I/O voltage supply, 1.8 or 2.8 volts.

  port:
    $ref: /schemas/graph.yaml#/$defs/port-base
    additionalProperties: false

    properties:
      endpoint:
        $ref: /schemas/media/video-interfaces.yaml#
        unevaluatedProperties: false

        properties:
          data-lanes:
            items:
              - const: 1
              - const: 2

        required:
          - data-lanes
          - link-frequencies

required:
  - compatible
  - reg
  - clocks
  - vdda-supply
  - vddd-supply
  - vddio-supply
  - port

unevaluatedProperties: false

examples:
  - |
      #include <dt-bindings/gpio/gpio.h>

      i2c {
          #address-cells = <1>;
          #size-cells = <0>;

          camera@2d {
              compatible = "samsung,s5k5e8";
              reg = <0x2d>;
              clocks = <&camera_mclk 0>;
              assigned-clocks = <&camera_mclk 0>;
              assigned-clock-rates = <24000000>;
              reset-gpios = <&gpio1 10 GPIO_ACTIVE_LOW>;
              powerdown-gpios = <&gpio1 11 GPIO_ACTIVE_LOW>;
              vdda-supply = <&vreg_2p8>;
              vddd-supply = <&vreg_1p2>;
              vddio-supply = <&vreg_1p8>;

              port {
                  endpoint {
                      data-lanes = <1 2>;
                      link-frequencies = /bits/ 64 <420000000>;
                      remote-endpoint = <&mipi_csi2_ep>;
                  };
              };
          };
      };
...
```
